## package/php-event/Config.in
```kconfig
config BR2_PACKAGE_PHP_EVENT
	bool "php-event"
	depends on BR2_PACKAGE_PHP
	select BR2_PACKAGE_EVENT
	help
	  PHP interface to libevent library

	  http://pecl.php.net/package/event
```

## package/php-meminfo/Config.in
```kconfig
config BR2_PACKAGE_PHP_MEMINFO
	bool "php-meminfo"
	depends on BR2_PACKAGE_PHP
	help
	  PHP Meminfo is a PHP extension that gives you insights
	  on the PHP memory content.

          https://github.com/BitOne/php-meminfo
```

## package/php-uv/Config.in
```kconfig
config BR2_PACKAGE_PHP_UV
	bool "php-uv"
	depends on BR2_PACKAGE_PHP
	select BR2_PACKAGE_LIBUV
	help
	  PHP UV libuv wrapper

	  http://pecl.php.net/package/uv
```
